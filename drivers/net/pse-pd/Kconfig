## drivers/net/pse-pd/Kconfig
```kconfig
# SPDX-License-Identifier: GPL-2.0-only
#
# Ethernet Power Sourcing Equipment drivers
#

menuconfig PSE_CONTROLLER
	bool "Ethernet Power Sourcing Equipment Support"
	help
	  Generic Power Sourcing Equipment Controller support.

	  If unsure, say no.

if PSE_CONTROLLER

config PSE_REGULATOR
	tristate "Regulator based PSE controller"
	depends on REGULATOR || COMPILE_TEST
	help
	  This module provides support for simple regulator based Ethernet Power
	  Sourcing Equipment without automatic classification support. For
	  example for basic implementation of PoDL (802.3bu) specification.

config PSE_PD69200
	tristate "PD69200 PSE controller"
	select FW_UPLOAD
	help
	  This module provides support for PD69200 regulator based Ethernet
	  Power Sourcing Equipment.

endif
```
